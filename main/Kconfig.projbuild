## main/Kconfig.projbuild
```kconfig
menu "AVA Voice / Louder ESP32 Rev H6"

    config HEADSET_NAME
        string "Bluetooth headset name"
        default "Rockerz 258 Pro+"
        help
            Bluetooth headset name to search and connect automatically.

    config HFP_MIC_DEFAULT_GAIN
        int "Default HFP microphone gain (VGM)"
        range 0 15
        default 10
        help
            Initial HFP microphone gain after the Service Level Connection is
            established. The headset can subsequently change this value with
            AT+VGM (range 0..15). Gain 10 keeps the existing HFP mixer level.

    menu "Louder ESP32 Rev H6 audio hardware"

        config I2S_BCLK_GPIO
            int "I2S BCLK/SCK GPIO"
            default 26
            help
                Louder ESP32 Rev H6 TAS5805M BCLK is GPIO26.

        config I2S_LRCLK_GPIO
            int "I2S LRCLK/WS GPIO"
            default 25
            help
                Louder ESP32 Rev H6 TAS5805M WS/LRCLK is GPIO25.

        config I2S_DOUT_GPIO
            int "I2S DOUT GPIO"
            default 22
            help
                Louder ESP32 Rev H6 TAS5805M SDIN is GPIO22.

        config LOUDER_TAS5805M_SDA_GPIO
            int "TAS5805M I2C SDA GPIO"
            default 21
            help
                Louder ESP32 Rev H6 fixed board connection: GPIO21.

        config LOUDER_TAS5805M_SCL_GPIO
            int "TAS5805M I2C SCL GPIO"
            default 27
            help
                Louder ESP32 Rev H6 fixed board connection: GPIO27.

        config LOUDER_TAS5805M_PWDN_GPIO
            int "TAS5805M PWDN GPIO"
            default 33
            help
                Louder ESP32 Rev H6 fixed board connection: GPIO33.

        config LOUDER_TAS5805M_FAULT_GPIO
            int "TAS5805M FAULT# GPIO"
            default 34
            help
                Louder ESP32 Rev H6 fixed board connection: GPIO34 (input only).

        config LOUDER_TAS5805M_I2C_ADDR
            int "TAS5805M I2C address (decimal)"
            range 44 47
            default 45
            help
                TAS5805M address. 45 decimal is 0x2D and is the Louder default.

        config LOUDER_TAS5805M_I2C_FREQ_HZ
            int "TAS5805M I2C frequency"
            range 50000 400000
            default 100000

        config LOUDER_ANALOG_GAIN_STEPS
            int "TAS5805M analog attenuation steps (0.5 dB each)"
            range 0 31
            default 0
            help
                0 = 0 dB analog attenuation, 12 = -6 dB, 31 = -15.5 dB.
                Keep 0 unless you intentionally want to limit maximum output power.

    endmenu

    menu "CM108B USB audio input / central mixer"

        config CM108B_BCLK_GPIO
            int "CM108B DASCLK/BCLK GPIO"
            default 18
            help
                CM108B I2S bit clock output. Connect DASCLK to ESP32 GPIO18.

        config CM108B_LRCLK_GPIO
            int "CM108B DALRCK/LRCLK GPIO"
            default 19
            help
                CM108B I2S word-select output. Connect DALRCK to ESP32 GPIO19.

        config CM108B_DATA_GPIO
            int "CM108B SDOUT/DATA GPIO"
            default 23
            help
                CM108B I2S playback data output. Connect SDOUT to ESP32 GPIO23.

        config CM108B_DIAG_RX_STATS
            bool "Log CM108B RX transport statistics"
            default y
            help
                Logs complete 5 ms RX blocks, partial driver reads, timeouts,
                I2S errors, incomplete blocks, FIFO drops and mixer underflows
                every 2 seconds, including windows where no DMA block arrives.

        config CM108B_DIAG_CLOCK_PROBE
            bool "Measure CM108B DASCLK and DALRCK with ESP32 PCNT"
            default y
            help
                Uses two ESP32 pulse-counter units to measure GPIO18/DASCLK and
                GPIO19/DALRCK without an oscilloscope. Expected during 48 kHz
                playback: about 3.072 MHz DASCLK and 48 kHz DALRCK (ratio ~64).

        config CM108B_RAW_USE_LOWER16
            bool "Use lower 16 bits of each raw 32-bit CM108B slot"
            default n
            help
                Diagnostic option. Default extracts the upper 16 bits [31:16].
                Enable only if RAW peak/sample logs show PCM is in [15:0].

        config CM108B_DIAG_1KHZ_TONE
            bool "Replace CM108B audio with internal 1 kHz diagnostic tone"
            default n
            help
                Replaces only the USB/CM108B mixer source with a locally generated
                1 kHz sine. If this tone is clean, I2S0/TAS5805M/speaker are good
                and distortion is confirmed to be on the CM108B I2S1 RX side.

        config AUDIO_MIX_USB_GAIN_PERCENT
            int "Samsung/CM108B mixer gain (%)"
            range 0 100
            default 70
            help
                Gain applied to USB audio before mixing.

        config AUDIO_MIX_HFP_GAIN_PERCENT
            int "HFP microphone mixer gain (%)"
            range 0 100
            default 100
            help
                Gain applied to the resampled headset microphone before mixing.

        config AUDIO_MIX_JINGLE_GAIN_PERCENT
            int "AVA jingle mixer gain (%)"
            range 0 100
            default 100

        config AUDIO_MIX_JINGLE_DUCK_PERCENT
            int "USB/HFP level while AVA jingle plays (%)"
            range 0 100
            default 0
            help
                0 mutes USB/HFP while the connection jingle is active.

    endmenu

    menu "Potentiometer volume control"

        config VOLUME_POT_GPIO
            int "Potentiometer ADC GPIO"
            default 36
            help
                Default GPIO36 = ADC1_CH0 on the classic ESP32 and is free on
                Louder ESP32 Rev H6. Connect potentiometer wiper here.

        config VOLUME_MAX_PERCENT
            int "Maximum logical volume (%)"
            range 1 100
            default 60
            help
                Keeps the previous project behavior: full potentiometer travel
                reaches 60% linear amplitude (about -4.5 dB in the TAS5805M DSP).

        config VOLUME_HYSTERESIS_PERCENT
            int "Volume hysteresis (%)"
            range 1 10
            default 2

        config VOLUME_POLL_INTERVAL_MS
            int "Potentiometer polling interval (ms)"
            range 20 1000
            default 100

    endmenu

    config ENABLE_SD_RECORDING
        bool "Enable legacy SDMMC audio recording"
        default n
        help
            Disabled by default for Louder ESP32 Rev H6. The old Amped project
            used the ESP32 default SDMMC pins, which overlap H6 peripherals.
            Only enable after adapting the SD wiring/pin mapping for your hardware.

    if ENABLE_SD_RECORDING

        config FORMAT_IF_MOUNT_FAILED
            bool "Format card if mount failed"
            default n

        choice SDMMC_BUS_WIDTH
            prompt "SD/MMC bus width"
            default SDMMC_BUS_WIDTH_1

            config SDMMC_BUS_WIDTH_4
                bool "4 lines (D0-D3)"

            config SDMMC_BUS_WIDTH_1
                bool "1 line (D0)"
        endchoice

    endif

    config ENABLE_HEADSET_RESET_GPIO
        bool "Enable external GPIO long-press for clearing saved headset"
        default n
        help
            Disabled on H6 by default because GPIO12 belongs to the onboard RGB
            LED and GPIO39 to the IR receiver. The serial command headset-reset
            remains available. Enable only if you wire a dedicated external pin.

    if ENABLE_HEADSET_RESET_GPIO
        config HEADSET_RESET_GPIO
            int "External headset reset GPIO"
            default 2
        config HEADSET_RESET_ACTIVE_HIGH
            bool "Reset input is active HIGH"
            default y
    endif

endmenu
```

## sdkconfig.defaults
```kconfig
# Override some defaults so BT stack is enabled and
# Classic BT is enabled
CONFIG_BT_ENABLED=y
CONFIG_BT_BLE_ENABLED=n
CONFIG_BTDM_CTRL_MODE_BR_EDR_ONLY=y
CONFIG_BTDM_CTRL_BR_EDR_MAX_SYNC_CONN=1
CONFIG_BT_BLUEDROID_ENABLED=y
CONFIG_BT_CLASSIC_ENABLED=y
CONFIG_BT_HFP_ENABLE=y
CONFIG_BT_HFP_AG_ENABLE=y
CONFIG_BT_HFP_CLIENT_ENABLE=n
CONFIG_BT_HFP_AUDIO_DATA_PATH_HCI=y
CONFIG_BTDM_CTRL_BR_EDR_SCO_DATA_PATH_HCI=y

# Louder ESP32 Rev H6 hardware defaults
CONFIG_I2S_BCLK_GPIO=26
CONFIG_I2S_LRCLK_GPIO=25
CONFIG_I2S_DOUT_GPIO=22
CONFIG_LOUDER_TAS5805M_SDA_GPIO=21
CONFIG_LOUDER_TAS5805M_SCL_GPIO=27
CONFIG_LOUDER_TAS5805M_PWDN_GPIO=33
CONFIG_LOUDER_TAS5805M_FAULT_GPIO=34
CONFIG_LOUDER_TAS5805M_I2C_ADDR=45
CONFIG_LOUDER_TAS5805M_I2C_FREQ_HZ=100000
CONFIG_LOUDER_ANALOG_GAIN_STEPS=0
CONFIG_VOLUME_POT_GPIO=36
CONFIG_VOLUME_MAX_PERCENT=60
CONFIG_VOLUME_HYSTERESIS_PERCENT=2
CONFIG_VOLUME_POLL_INTERVAL_MS=100
# CONFIG_ENABLE_SD_RECORDING is not set
# CONFIG_ENABLE_HEADSET_RESET_GPIO is not set
```

## sdkconfig.defaults.esp32
```kconfig
CONFIG_ESPTOOLPY_FLASHMODE_DIO=y
CONFIG_ESPTOOLPY_FLASHSIZE_4MB=y

CONFIG_PARTITION_TABLE_CUSTOM=y
CONFIG_PARTITION_TABLE_CUSTOM_FILENAME="partitions.csv"
CONFIG_PARTITION_TABLE_FILENAME="partitions.csv"

CONFIG_COMPILER_OPTIMIZATION_PERF=y

CONFIG_HFP_MIC_DEFAULT_GAIN=10

CONFIG_ESP_DEFAULT_CPU_FREQ_MHZ_240=y
# CM108B USB audio / central mixer
CONFIG_CM108B_BCLK_GPIO=18
CONFIG_CM108B_LRCLK_GPIO=19
CONFIG_CM108B_DATA_GPIO=23
CONFIG_CM108B_DIAG_RX_STATS=y
# CONFIG_CM108B_DIAG_1KHZ_TONE is not set
CONFIG_AUDIO_MIX_USB_GAIN_PERCENT=70
CONFIG_AUDIO_MIX_HFP_GAIN_PERCENT=100
CONFIG_AUDIO_MIX_JINGLE_GAIN_PERCENT=100
CONFIG_AUDIO_MIX_JINGLE_DUCK_PERCENT=0
```
